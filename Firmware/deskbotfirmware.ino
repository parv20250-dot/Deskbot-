//This code handles the hardware aspect of my ai deskbot
//It does not work or run the ai by itself without the corresponding ai files,
//  it only covers communication between the ESP-32 and the server.

#include <Arduino.h>
#include <Wire.h>
#include <WiFi.h>
#include <HTTPClient.h>
#include <Adafruit_GFX.h>
#include <Adafruit_SSD1306.h>
#include <ESP_I2S.h>
#include <esp_random.h> 
//I include all the libraries that will be necessary throughout my ccode

#define MIC_SCK 4
#define MIC_WS 5
#define MIC_SD 6
#define BUZZER_PIN 7
#define SDA_PIN 8
#define SCL_PIN 9
#define Button_1 1
#define Button_2 2
//All the components connected to the ESP and their GPIO pins are mentioned
//and defined wrt schematic anol
#define OLED_ADDR 0x3C
#define SAMPLE_RATE 16000 //audio sampling rate
#define doubpress_MS 400 //two presses within 200 ms 
#define longpress_MS 1000 //press for 1000 ms (1sec) for long press
#define characters 20 //characters per line
#define visible 5 //5 lines shown tg
#define max_lines 30 //only 30 lines maximum, 5 at a time

const char*WIFI_SSID = "name"; //removed for privacy, add wifi name
const char*WIFI_PASS = "pass";//removed for privacy, wifi password
const char*server_url = "url";
//removed for privacy, http://ipaddress:8000 //server port
const char*API_key ="key"; //removed for privacy, generate any key HAS TO BE SAME AS
//BACKEND .emv one

enum expressions {HAPPY,SLEEPY,CUTE,shy,SURPRISED,CAT1,cat2,CRY,DED,UwU,
    expressions_count}; //expressions possible
enum states {idle, draft,recording,uploading,reply}; //responses

struct Button{uint8_t pin; bool raw; bool stable; uint32_t lastchange;
uint32_t pressedat; bool justpressed; bool justreleased;};
//everything button has, pin, reading, state, last change, press, pressed?,released?
Adafruit_SSD1306 display(128,64,&Wire,-1);
//display, 128 pixel wide, 64 pixel longgg, no hardware rest pin so -1
I2SClass i2s;
bool displayworky = false; //checks if display working starts off as false
int state = idle; //state starts as idle
int currface = SURPRISED; //starts off surprised
uint32_t nextfaceat =0;//next face when
uint32_t lastcheckedat =0; //when server was last checked for updates
uint32_t beependat =0; //when beep will end
bool studymode = false; //study mode starts off as false
bool aheld= false; //But A currently held, starts false
bool bheld =false; //But B held rn, start false
int aclicked = 0; //tracks button A clicks start off as zero
int linecount =0; //tracks no of lines
int top =0; //top line (for scrolling)
String drafttext,lines[max_lines]; //stores drafts, first 40 lines in it for screen
uint32_t alastclick =0;
uint32_t scrollat =0;
Button buttonA ={Button_1,false,false,0,0,false,false};
//creates button object with struct earlier
Button buttonB = {Button_2,false,false,0,0,false,false};
//detsamma
uint8_t*rec = nullptr; //recording currently nun
size_t audmax =0;
size_t audbytes =0; //audio max capacity,curr in bytes

const unsigned char happyface[]PROGMEM={
    0x00, 0x00, 0x00, 0x00, 0x00, 0x00, 0x00, 0x00, 0x00, 0x00, 0x00, 0x00, 0x00, 0x00, 0x00, 0x00, 
	0x00, 0x00, 0x00, 0x00, 0x00, 0x00, 0x00, 0x00, 0x00, 0x00, 0x00, 0x00, 0x00, 0x00, 0x00, 0x00, 
	0x00, 0x00, 0x00, 0x00, 0x00, 0x00, 0x00, 0x00, 0x00, 0x00, 0x00, 0x00, 0x00, 0x00, 0x00, 0x00, 
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	0x00, 0x00, 0x00, 0x00, 0x00, 0x00, 0x00, 0x00, 0x00, 0x00, 0x00, 0x00, 0x00, 0x00, 0x00, 0x00};
//happy img
const unsigned char sleepyface []PROGMEM ={
    0x00, 0x00, 0x00, 0x00, 0x00, 0x00, 0x00, 0x00, 0x00, 0x00, 0x00, 0x00, 0x00, 0x00, 0x00, 0x00, 
	0x00, 0x00, 0x00, 0x00, 0x00, 0x00, 0x00, 0x00, 0x00, 0x00, 0x00, 0x00, 0x00, 0x00, 0x00, 0x00, 
	0x00, 0x00, 0x00, 0x00, 0x00, 0x00, 0x00, 0x00, 0x00, 0x00, 0x00, 0x00, 0x00, 0x00, 0x00, 0x00, 
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	0x00, 0x00, 0x00, 0x00, 0x00, 0x00, 0x00, 0x00, 0x00, 0x00, 0x00, 0x00, 0x00, 0x00, 0x00, 0x00};
//end of sleepy face img
const unsigned char cuteface[]PROGMEM={0x00, 0x00, 0x00, 0x00, 0x00, 0x00, 0x00, 0x00, 0x00, 0x00, 0x00, 0x00, 0x00, 0x00, 0x00, 0x00, 
	0x00, 0x00, 0x00, 0x00, 0x00, 0x00, 0x00, 0x00, 0x00, 0x00, 0x00, 0x00, 0x00, 0x00, 0x00, 0x00, 
	0x00, 0x00, 0x00, 0x00, 0x00, 0x00, 0x00, 0x00, 0x00, 0x00, 0x00, 0x00, 0x00, 0x00, 0x00, 0x00, 
	0x00, 0x00, 0x00, 0x00, 0x00, 0x00, 0x00, 0x00, 0x00, 0x00, 0x00, 0x00, 0x00, 0x00, 0x00, 0x00, 
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	0x00, 0x00, 0x00, 0x00, 0x00, 0x00, 0x00, 0x00, 0x00, 0x00, 0x00, 0x00, 0x00, 0x00, 0x00, 0x00};
//end of cute face
const unsigned char shyface[]PROGMEM ={0x00, 0x00, 0x00, 0x00, 0x00, 0x00, 0x00, 0x00, 0x00, 0x00, 0x00, 0x00, 0x00, 0x00, 0x00, 0x00, 
	0x00, 0x00, 0x00, 0x00, 0x00, 0x00, 0x00, 0x00, 0x00, 0x00, 0x00, 0x00, 0x00, 0x00, 0x00, 0x00, 
	0x00, 0x00, 0x00, 0x00, 0x00, 0x00, 0x00, 0x00, 0x00, 0x00, 0x00, 0x00, 0x00, 0x00, 0x00, 0x00, 
	0x00, 0x00, 0x00, 0x00, 0x00, 0x00, 0x00, 0x00, 0x00, 0x00, 0x00, 0x00, 0x00, 0x00, 0x00, 0x00, 
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	0x00, 0x00, 0x00, 0x00, 0x00, 0x00, 0x00, 0x00, 0x00, 0x00, 0x00, 0x00, 0x00, 0x00, 0x00, 0x00};
//end of shy face
const unsigned char surpface[]PROGMEM ={0x00, 0x00, 0x00, 0x00, 0x00, 0x00, 0x00, 0x00, 0x00, 0x00, 0x00, 0x00, 0x00, 0x00, 0x00, 0x00, 
	0x00, 0x00, 0x00, 0x00, 0x00, 0x00, 0x00, 0x00, 0x00, 0x00, 0x00, 0x00, 0x00, 0x00, 0x00, 0x00, 
	0x00, 0x00, 0x00, 0x00, 0x00, 0x00, 0x00, 0x00, 0x00, 0x00, 0x00, 0x00, 0x00, 0x00, 0x00, 0x00, 
	0x00, 0x00, 0x00, 0x00, 0x00, 0x00, 0x00, 0x00, 0x00, 0x00, 0x00, 0x00, 0x00, 0x00, 0x00, 0x00, 
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	0x00, 0x00, 0x00, 0x00, 0x00, 0x00, 0x00, 0x00, 0x00, 0x00, 0x00, 0x00, 0x00, 0x00, 0x00, 0x00};
//end of surprised face
const unsigned char cat1face[]PROGMEM={0x00, 0x00, 0x00, 0x00, 0x00, 0x00, 0x00, 0x00, 0x00, 0x00, 0x00, 0x00, 0x00, 0x00, 0x00, 0x00, 
	0x00, 0x00, 0x00, 0x00, 0x00, 0x00, 0x00, 0x00, 0x00, 0x00, 0x00, 0x00, 0x00, 0x00, 0x00, 0x00, 
	0x00, 0x00, 0x00, 0x00, 0x00, 0x00, 0x00, 0x00, 0x00, 0x00, 0x00, 0x00, 0x00, 0x00, 0x00, 0x00, 
	0x00, 0x00, 0x00, 0x00, 0x00, 0x00, 0x00, 0x00, 0x00, 0x00, 0x00, 0x00, 0x00, 0x00, 0x00, 0x00, 
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	0x00, 0x00, 0x00, 0x00, 0x00, 0x00, 0x00, 0x00, 0x00, 0x00, 0x00, 0x00, 0x00, 0x00, 0x00, 0x00};
//end of cat1
const unsigned char cat2face[]PROGMEM ={0x00, 0x00, 0x00, 0x00, 0x00, 0x00, 0x00, 0x00, 0x00, 0x00, 0x00, 0x00, 0x00, 0x00, 0x00, 0x00, 
	0x00, 0x00, 0x00, 0x00, 0x00, 0x00, 0x00, 0x00, 0x00, 0x00, 0x00, 0x00, 0x00, 0x00, 0x00, 0x00, 
	0x00, 0x00, 0x00, 0x00, 0x00, 0x00, 0x00, 0x00, 0x00, 0x00, 0x00, 0x00, 0x00, 0x00, 0x00, 0x00, 
	0x00, 0x00, 0x00, 0x00, 0x00, 0x00, 0x00, 0x00, 0x00, 0x00, 0x00, 0x00, 0x00, 0x00, 0x00, 0x00, 
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	0x00, 0x00, 0x00, 0x00, 0x00, 0x00, 0x00, 0x00, 0x00, 0x00, 0x00, 0x00, 0x00, 0x00, 0x00, 0x00};
//cat2 endddd
const unsigned char cryface[]PROGMEM ={0x00, 0x00, 0x00, 0x00, 0x00, 0x00, 0x00, 0x00, 0x00, 0x00, 0x00, 0x00, 0x00, 0x00, 0x00, 0x00, 
	0x00, 0x00, 0x00, 0x00, 0x00, 0x00, 0x00, 0x00, 0x00, 0x00, 0x00, 0x00, 0x00, 0x00, 0x00, 0x00, 
	0x00, 0x00, 0x00, 0x00, 0x00, 0x00, 0x00, 0x00, 0x00, 0x00, 0x00, 0x00, 0x00, 0x00, 0x00, 0x00, 
	0x00, 0x00, 0x00, 0x00, 0x00, 0x00, 0x00, 0x00, 0x00, 0x00, 0x00, 0x00, 0x00, 0x00, 0x00, 0x00, 
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	0x00, 0x00, 0x00, 0x00, 0x00, 0x00, 0x00, 0x00, 0x00, 0x00, 0x00, 0x00, 0x00, 0x00, 0x00, 0x00};
//end of cryy
const unsigned char dedface[]PROGMEM ={0x00, 0x00, 0x00, 0x00, 0x00, 0x00, 0x00, 0x00, 0x00, 0x00, 0x00, 0x00, 0x00, 0x00, 0x00, 0x00, 
	0x00, 0x00, 0x00, 0x00, 0x00, 0x00, 0x00, 0x00, 0x00, 0x00, 0x00, 0x00, 0x00, 0x00, 0x00, 0x00, 
	0x00, 0x00, 0x00, 0x00, 0x00, 0x00, 0x00, 0x00, 0x00, 0x00, 0x00, 0x00, 0x00, 0x00, 0x00, 0x00, 
	0x00, 0x00, 0x00, 0x00, 0x00, 0x00, 0x00, 0x00, 0x00, 0x00, 0x00, 0x00, 0x00, 0x00, 0x00, 0x00, 
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	0x00, 0x00, 0x00, 0x00, 0x00, 0x00, 0x00, 0x00, 0x00, 0x00, 0x00, 0x00, 0x00, 0x00, 0x00, 0x00
}; //end of dead face
const unsigned char uwuface[]PROGMEM ={0x00, 0x00, 0x00, 0x00, 0x00, 0x00, 0x00, 0x00, 0x00, 0x00, 0x00, 0x00, 0x00, 0x00, 0x00, 0x00, 
	0x00, 0x00, 0x00, 0x00, 0x00, 0x00, 0x00, 0x00, 0x00, 0x00, 0x00, 0x00, 0x00, 0x00, 0x00, 0x00, 
	0x00, 0x00, 0x00, 0x00, 0x00, 0x00, 0x00, 0x00, 0x00, 0x00, 0x00, 0x00, 0x00, 0x00, 0x00, 0x00, 
	0x00, 0x00, 0x00, 0x00, 0x00, 0x00, 0x00, 0x00, 0x00, 0x00, 0x00, 0x00, 0x00, 0x00, 0x00, 0x00, 
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	0x00, 0x00, 0x00, 0x00, 0x00, 0x00, 0x00, 0x00, 0x00, 0x00, 0x00, 0x00, 0x00, 0x00, 0x00, 0x00
}; //end of uwu faceee
//THATS ALL THE EXPRESSIONSSS_________________________________________________
void drawface(){ //draws faceee
    const unsigned char*face = surpface;
    if (currface == SURPRISED){face =surpface;}
    if(currface == SLEEPY){face =sleepyface;}
    if (currface == CUTE){face =cuteface;}
    if (currface == shy){face=shyface;}
    if(currface==HAPPY){face=happyface;}
    if(currface==CAT1){face=cat1face;}
    if(currface==cat2){face=cat2face;}
    if(currface==UwU){face=uwuface;}
    if(currface==DED){face=dedface;}
    if(currface==CRY){face=cryface;}
	display.clearDisplay(); //clears display
    display.drawBitmap(0,0,face,128,64,WHITE); 
    //all emoji bmps loaded wrt to their expressions, drawn on screen in white
    if (studymode){
        display.setTextSize(1);display.setTextColor(WHITE);
        display.setCursor(0,0);display.print("Study");}
    display.display();} //mentions if study mode STUDY, draws display
void updateface(){//chooses a new face and draws itt
    currface=random(expressions_count); //picks random expression from expressions
    nextfaceat=millis()+random(40000,120000);//picks random time for next face
    //from 40-120 secs (no too much flickering)
    drawface();} //draws it
void idlenow(){state=idle;updateface();} //become idle shows random new face
void showMessage(const char*txt){ //shows message,no modifu
    display.clearDisplay(); //clears first
    display.setTextSize(1);
    display.setTextColor(WHITE); //SETS SIZE AND COLOR FOR TEXT
    display.setCursor(20,28); //starts there
    display.print(txt); //prints message
    display.display();} //updates the display
void drawtext(){
    display.clearDisplay();
    display.fillRect(0,0,128,10,WHITE); //draws white rectangle for contrast text
    display.setTextSize(1);//text is size 1
    display.setTextColor(BLACK); //text is black
    display.setCursor(2,2); //starts at 2,2
    if (state ==draft){display.print("Replydraft");}
    else{display.print("Deskbot");} //if draft draft else deskbot
    display.setTextColor(WHITE);
    for (int i =0; i<visible && top+i < linecount;i++){
        display.setCursor(0,12+i*9);
        display.print(lines[top+i]);} //starts at line 0, if too many lines 
        //scrolls down, increases i each time (line 0 i 0),find array prints,loop goes onn
    display.setCursor(0,56);
    if (state ==draft){display.print("A send, Ax2 nopee,B talk");}
    else{display.print("A to close,B to talk");}
    //if in draft mode shows draft related instructions else shows bot general ones
    display.display();} //updates display
void showtext (const String & body){
    //formats text, string input
    String str ="";
    for (size_t i=0;i<body.length();i++){ //starts at 0 to length,increase by 1 loop
         unsigned char c =body[i]; 
         if(c == '\n' or c=='t'){str+=' ';}//new lines,tabs become spaces
		 else if(c>=32 && c<127){str+=(char)c;}} //keeps normal characters, drops the rest
    linecount=0;
    String cur="";
    int i=0; //position
    int l =str.length(); //total length
    while (i<l && linecount< max_lines){ //while lines left,less than maximum possible
        int j=i;
        while(j<l && str[j]!=' ')j++;
        String w =str.substring(i,j); //word bw i,j
        i=j+1; //next word
        while((int)w.length()> characters && linecount< max_lines){
            if(cur.length()>0){lines[linecount]=cur;linecount++;cur="";}
            if(linecount>=max_lines)break;
            lines[linecount]=w.substring(0,characters); linecount++; //first 20 characters of long word
            w =w.substring(characters);} //removes from w
        if (w.length()==0){continue;} //empty word skipped
        if (cur.length()==0){cur =w;} //empty line? word
        else if((int)(cur.length()+1+w.length()) <= characters){
            cur +=" "+w;} //adds word
        else if(linecount< max_lines){lines[linecount]=cur;linecount++;cur =w;}}
    if (cur.length()>0 &&linecount< max_lines){ //lines left?
        lines[linecount]=cur;linecount++;} //saves and moves on
    top =0; //starts at top
    scrollat = millis()+2500;
    drawtext();}
void newdraft(const String& text){
    drafttext =text;state=draft;showtext(drafttext);ledcWriteTone(BUZZER_PIN,1760);
    beependat =millis()+200;} //draft,shows draft beeps to lmk

String req(const char*path, const char*type, const uint8_t*body,size_t len, 
int timeoutMS){
	if (WiFi.status() != WL_CONNECTED)return"";
	 //If no wifi return empty string
	HTTPClient http; //client object http
	http.setConnectTimeout(4000); //timeout after 4 secs of no conn
	http.setTimeout(timeoutMS); //timeout for an activity after conn
	http.begin(String(server_url)+path); //combines url with path(endpoint)
	http.addHeader("X-Deskbot-Key",API_key); //adds API key to request
	//authentication
	int code; 
	if (body){
		http.addHeader("Content-Type",type);
		code = http.POST((uint8_t*)body,len);}
	else code = http.GET(); //if body then it posts info to server
	//with content type deets and stores responses, otherwise no body=it needs
	//input from server sends a get request 
	String ans;
	if (code ==200){ans =http.getString();}//if code is 200,sucess,gets it and stores
	else{ans ="";} //returns empty string otherwise
	http.end(); //closes the connection
	return ans;} //returns the response
String post(const char* path, const char*text){
	return req(path,"text/plain",(const uint8_t*)text, strlen(text),3000);}
	//sets up post to make it easier
void decide(const char* todo){
	post("/device/decision",todo); idlenow();}
	//sends what to do to backend returns device to idle
void showstatus(){
	String stats;
	if (WiFi.status()==WL_CONNECTED){stats ="IP"+ WiFi.localIP().toString();}
	//if wifi connected shows deets after converting to str
	else{stats ="wifi no connecty";}//else shows wigi not conn
	stats+= "//SERVER:"+String(server_url); //adds server deets
	if (studymode){stats += "//STUDY ON";}
	else{stats+="//study off";}
	state =reply;
	showtext(stats);} //shows stats of whats running, wifi, server deets,mode
void wavheader(uint8_t*where,uint32_t amt){
	uint32_t v[11]={ 0x46464952,36 +amt,0x45564157,0x20746d66,16, 
		0x00010001,SAMPLE_RATE, SAMPLE_RATE * 2, 
		0x00100002,0x61746164,amt };memcpy(where,v,44);}
		//file format,size,wav format,audio format,samaple rate, byte rate, bits
		//per sample and audio data length, wav format idenitifiers
		//copies it from v to where and stores it
void startrec(int newstate){
	audbytes =0;
	state =newstate;
	showMessage("Listening....i think?");} //resets audio amt then changes state
	//shows thinking msg¨
#define audio_prefix "--deskbotbnd\r\nContent-Disposition:form-data;name=\"audio\";filename=\"voice.wav\"\r\nContent-Type:audio/wav\r\n\r\n"
#define audio_suffix "\r\n--deskbotbnd--\r\n"
#define prefix_len (sizeof(audio_prefix)- 1)
#define suffix_len (sizeof(audio_suffix)- 1)
void record(){
	int32_t samples[128];
	size_t no =i2s.readBytes((char*)samples, sizeof(samples))/4;
	//reads mic data basically, array is int, size then divides into no of 32 bit samples
	uint8_t*out = rec+prefix_len +44;
	//prefix space and wav header space
	for (size_t i=0;i<no;i++){ //loops through all samples goes forward when i < no
		if(audbytes+2>audmax)break; //checks space (audmax is max space)
		int32_t v=samples[i]>>14; //shifts sample
		if (v>32767)v=32767;
		if (v<-32768)v=-32768; //value fits in reqd range
		out[audbytes] = v&0xFF;
		audbytes++; //extracts lowest 8 bits and stores em
		out[audbytes]=(v>>8)&0xFF;
		audbytes++;}} //next 8 bits and stores em, does this till either all samples
		//done OR max capacity (bytes) reached 
void finishrec(){
 bool dictating=(state==uploading); //uploading state = recording audio reply
 if (audbytes<3200){ //if audio less than 0.1 secs
  if (dictating){state =draft;showtext(drafttext);}
  else{idlenow();}
  return;}//if recording too short ends function changes based on
  //what was being done before
 showMessage("Thinking...");
 memcpy(rec, audio_prefix,prefix_len); //writes prefix
 wavheader(rec+prefix_len,audbytes); //finds position,writes header after prefix
 memcpy(rec+prefix_len+44+audbytes,audio_suffix,suffix_len);
 //suffix after data
 const char* path;
 if(dictating){path ="/device/dictate";}
 else{path="/voice_text";} //sets paths depending on what state
 String response = req(path,"multipart/form-data; boundary=deskbotbnd",rec,
 (prefix_len+44+audbytes+suffix_len),45000); //creates a string and sends, waits 45 secs
 if(dictating){
  if(response.length()>0){newdraft(response);}
  else{state=draft;showtext(drafttext);}} //if server returned sumn new draft else nun
 else if(response.length()>0){ //not dictating
  state = reply;
  showtext(response); //state to reply and shows response
  ledcWriteTone(BUZZER_PIN,1760); //plays notif sound
  beependat=millis()+200;}
 else{idlenow();}} //if neither aka server empty idle state
void updatebutton(Button& b){ //updates button info
	uint32_t now = millis(); //now = ms since esp starts
	bool isdown =(digitalRead(b.pin)==LOW); //pressed or nay
	b.justpressed =false;
	b.justreleased =false;
	if (isdown!= b.raw){b.raw =isdown;b.lastchange=now;}
	//if there is a change then chnages button state, updates time of last change
	if (now -b.lastchange>=30 && isdown!= b.stable){
		//diff reading than stable, check time
		b.stable =isdown;
		if(isdown){b.justpressed =true;b.pressedat=now;}
		//if pressed then pressed is true,time pressed at is now
		else{b.justreleased =true;}}}//if not a press its a release
void singleA(){ //one press of A
	if (state ==draft)decide("approve");
	else if(state ==reply) idlenow();
	else if(state ==idle)showstatus();}
//if A is pressed once on draft approved, on reply closes reply, idle alr shows stats
void doubleA(){if (state =draft)decide("reject");}
//on draft screen double A rejects
void singleB(){
	if(state==idle)updateface();
	else if (state ==reply)idlenow();} //Button B handles idle and expressions
void changestudy(){
	String r =post("/device/study","change"); //posts to change study mode
	if (r.length() > 0) { if (r.indexOf("on") >= 0) {
		//if there on its true, else it returns -1 i.e it false
      studymode = true;}
    else {studymode = false;}
    drawface();}}
void buttonsfinale(uint32_t now){
	if (buttonA.justpressed){
		aclicked++;alastclick=now;} //if pressed updates
	if(buttonA.stable &&!aheld &&now-buttonA.pressedat >longpress_MS){
		//currently held, not alr held, longer than 1 sec
		aheld=true;aclicked=0;
		if (state ==idle)changestudy();} //idle then study mode
		if(buttonA.justreleased)aheld=false;  //resets hold flag
		if(aclicked>2){doubleA();aclicked=0;}//double click action, resets clicker
		else if(aclicked==1 &&!buttonA.stable &&now-alastclick> doubpress_MS){
			singleA();aclicked=0;} //one click, no longer pressed, not double
		if(buttonB.stable && !bheld &&now-buttonB.pressedat > longpress_MS){
			//B is pressed,no hold yet, long enough time
			bheld=true;
			if (rec&&(state==idle or state ==reply or state ==draft)){
				//if recording and state is idle reply or draft
				if (state==draft){startrec(uploading);}
				else{startrec(recording);}}}
			if (buttonB.justreleased){ //stop pressing button B
				if(bheld){bheld=false;
					if (state==uploading or state== recording)finishrec();}
					//if was recording finish
			else{singleB();}}} //stop pressing B actions

void setup(){
	Serial.begin(115200); //starts communiction
	pinMode(Button_1,INPUT_PULLUP); //signals, high when no press
	pinMode(Button_2,INPUT_PULLUP); //signals, high when no press
	ledcAttach(BUZZER_PIN,2000,10); //configures buzzer
	ledcWriteTone(BUZZER_PIN,0); //starts silent
	Wire.begin(SDA_PIN,SCL_PIN); //Sets up I2C communication lines for display
	Wire.setClock(300000); //I2C clock speed
	display.begin(SSD1306_SWITCHCAPVCC,0x3c); //Initialises display
	if(psramFound()){audmax =(size_t)SAMPLE_RATE*2*15;}
	//15 second audio, calculates space to allocate
	else{audmax =(size_t)SAMPLE_RATE*2*8;} //8secs
	size_t total =prefix_len+44+audmax+suffix_len; //total mem reqd
	if (psramFound()){rec =(uint8_t*)ps_malloc(total);} //allocates memory in psram
	else{rec=(uint8_t*)malloc(total);}//allocates memory in normal ram
	i2s.setPins(MIC_SCK,MIC_WS,-1,MIC_SD); //ASSIGNS DEFINES PINS
	i2s.begin(I2S_MODE_STD,SAMPLE_RATE,I2S_DATA_BIT_WIDTH_32BIT,
		I2S_SLOT_MODE_MONO, I2S_STD_SLOT_LEFT); //initialises mic
	showMessage("WiFi...");//shows a message while connecting
	WiFi.mode(WIFI_STA); //sets mode to connect to existing network
	WiFi.begin(WIFI_SSID,WIFI_PASS); //NETWORK nam e and password
	uint32_t t0 =millis(); //time starts
	while (WiFi.status() != WL_CONNECTED && millis()-t0 <15000)delay(200);
	//while wifi not connected and less than 15 secs have passed wai 200 ms
	//then tries again
	if (WiFi.status()== WL_CONNECTED){Serial.println(WiFi.localIP().toString());}
	//if wifi is connected, prints ip adress after making it str
	else{Serial.println("WIFI failedd");} //if no connect prints failes
	randomSeed(esp_random()); //generates random seed
	idlenow();}

	void loop(){
		uint32_t now= millis();
		updatebutton(buttonA);
		updatebutton(buttonB);
		buttonsfinale(now); //updates button info and both buttons actions
		if(beependat&&now >= beependat){
			ledcWriteTone(BUZZER_PIN,0);beependat=0;}
		//if there is a beep end at now is more than beep end,aka beep time over
		//silences buzzer then resets beep end at
		if(state == uploading or state == recording){record();}
		//if its in ask a question or record modes it records
		else if (state == idle){
			if (now >=nextfaceat)updateface(); //time to update face, updates face
			if(now-lastcheckedat>=2000){lastcheckedat=now;
			String r =req("/device/poll",nullptr,nullptr,0,2500);
			//study or idle
			if(r.startsWith("draft:"))newdraft(r.substring(6)); 
			//if response starts with draft then extracts conetent from 6 as new draft
			else if(r.length()&&(r.indexOf("study")>=0)!= studymode){
				//if it has characters, if there's study (else it'd be-1 so false) and diff
				studymode =!studymode; //updates mode
				drawface();}}}
			else if (linecount> visible && now >=scrollat){ 
				//line count more than what fits on screen at once, tiem to scroll
				if(top+visible > linecount){top=0;} //resets
				else{top=top +1;}//scrolls instead of starting over
				if(top ==0){scrollat = now+2000;} //2 s at beginning
				else{scrollat =now+1500;}//1s after
				drawtext();}}
//THE ENDDDDDDDD FINALLY



 
		



	














